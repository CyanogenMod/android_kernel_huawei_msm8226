/ {
        qrd_batterydata: qcom,battery-data {
               qcom,rpull-up-kohm = <68>;
               qcom,vref-batt-therm = <1800000>;
               /include/ "HB3742A0EBC_ATL_SCUD-4v35-2200mah.dtsi"
               /include/ "HB3742A0EBC_SDI_SWD-4v35-2200mah.dtsi"
        };
};

&pm8226_bms {
	qcom,battery-data = <&qrd_batterydata>;
	qcom,low-voltage-threshold = <3250000>;
};

&pm8226_chg {
	status = "okay";
	qcom,vddmax-mv = <4350>;
	qcom,vddsafe-mv = <4380>;
	qcom,tchg-mins = <512>;
	qcom,battery-data = <&qrd_batterydata>;
	qcom,batt-hot-percentage = <25>;
	qcom,batt-cold-percentage = <80>;
};
