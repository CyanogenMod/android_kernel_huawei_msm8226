/* gpio 23 and 110 is used for lcd, gpio 109 is for hall,gpio 64 is for sensor,so we delete it here */
/* Copyright (c) 2013, The Linux Foundation. All rights reserved.
 *
 * This program is free software; you can redistribute it and/or modify
 * it under the terms of the GNU General Public License version 2 and
 * only version 2 as published by the Free Software Foundation.
 *
 * This program is distributed in the hope that it will be useful,
 * but WITHOUT ANY WARRANTY; without even the implied warranty of
 * MERCHANTABILITY or FITNESS FOR A PARTICULAR PURPOSE.  See the
 * GNU General Public License for more details.
 */
&soc {
nc_gpio {
    compatible = "qcom,sleep_gpio";
    ngpio = <22>;
    gpio = <0 1 2 3 22 27 35 49 50 51 52 53 54 55 56 66 67 111 112 114 119 120>;
    status = "okay";
    };
};
